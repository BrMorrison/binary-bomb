## br2-external/Config.in
```kconfig
source "$BR2_EXTERNAL_BOMB_DEFUSAL_PATH/package/bomb/Config.in"
source "$BR2_EXTERNAL_BOMB_DEFUSAL_PATH/package/tutorial/Config.in"
```

## br2-external/configs/bomb-board_defconfig
```kconfig
BR2_arm=y
BR2_cortex_a15=y
BR2_TOOLCHAIN_BUILDROOT_MUSL=y
BR2_KERNEL_HEADERS_6_6=y
BR2_TOOLCHAIN_BUILDROOT_CXX=y
BR2_PACKAGE_HOST_GDB=y
BR2_PACKAGE_HOST_GDB_TUI=y
# BR2_PIC_PIE is not set
BR2_SSP_NONE=y
BR2_RELRO_NONE=y
BR2_TARGET_GENERIC_ISSUE=""
BR2_LINUX_KERNEL=y
BR2_LINUX_KERNEL_USE_CUSTOM_CONFIG=y
BR2_LINUX_KERNEL_CUSTOM_CONFIG_FILE="$(BR2_EXTERNAL_BOMB_DIFFUSAL_PATH)/board/bomb-board/kernel.config"
BR2_PACKAGE_BUSYBOX_CONFIG="$(BR2_EXTERNAL_BOMB_DIFFUSAL_PATH)/board/bomb-board/busybox.config"
BR2_PACKAGE_GDB=y
BR2_PACKAGE_ZLIB=y
BR2_PACKAGE_TMUX=y
BR2_PACKAGE_NANO=y
BR2_TARGET_ROOTFS_EXT2=y
BR2_TARGET_ROOTFS_EXT2_GZIP=y
# BR2_TARGET_ROOTFS_TAR is not set
```

## br2-external/package/bomb/Config.in
```kconfig
config BR2_PACKAGE_BOMB
    bool "binary-bomb"
    help
        The binary used for the bomb defusal game.
```

## br2-external/package/tutorial/Config.in
```kconfig
config BR2_PACKAGE_TUTORIAL
    bool "bomb-tutorial"
    help
        The a tutorial for the bomb defusal game
```
